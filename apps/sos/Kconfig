## apps/sos/Kconfig
```kconfig
menuconfig APP_SOS
    bool "SOS App"
    default y
		depends on LIB_SEL4 && (LIB_MUSL_C || LIB_SEL4_C) && LIB_SEL4_PLAT_SUPPORT && LIB_SEL4_VKA && LIB_SEL4_UTILS && LIB_UTILS && LIB_SEL4_CSPACE
    help
        Simple Operating System (aka AOS implementation)
```

## apps/tty_test/Kconfig
```kconfig
#
# Copyright 2014, NICTA
#
# This software may be distributed and modified according to the terms of
# the BSD 2-Clause license. Note that NO WARRANTY is provided.
# See "LICENSE_BSD2.txt" for details.
#
# @TAG(NICTA_BSD)
#

config APP_TTY_TEST
    bool "TTY test"
    depends on LIB_SEL4 && (LIB_MUSL_C || LIB_SEL4_C) && LIB_SEL4_PLAT_SUPPORT && LIB_SEL4_UTILS && LIB_UTILS 
    default y
    select HAVE_SEL4_APPS
    help
        A test program for printing over serial for AOS
```
